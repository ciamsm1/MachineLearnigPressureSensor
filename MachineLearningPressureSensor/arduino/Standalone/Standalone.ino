#include <SoftwareSerial.h>
#define BT_RXD 0
#define BT_TXD 1
SoftwareSerial bluetooth(BT_RXD, BT_TXD);

const int analogPin = A0;
const int height = 8;  // 행렬의 높이
const int width = 16;  // 행렬의 너비
const int newHeight = 16;  // 업스케일링된 행렬의 높이
const int newWidth = 32;  // 업스케일링된 행렬의 너비

int MaskedMatrix[8][16];
float FirstMatrix[8][16];
float ProcessedMatrix[8][16];
float UpscaledMatrix[16][32];
float weights[16][32] = 
{
    {-0.050648, -0.0460942, -0.0415404, -0.0463432, -0.0518143, -0.0351651, -0.0151128, -0.00547228, 0.0015653, 0.00297741, 0.00234391, 0.00629273, 0.0125327, 0.0233371, 0.0371844, 0.0461376, 
     0.00884942, 0.00879065, -0.0000396509, -0.0092539, -0.0118633, -0.00480793, 0.00443999, 0.00859989, 0.000642508, -0.00708501, -0.00571828, -0.00864861, -0.0325476, -0.0497936, -0.0521521, -0.0612764},
    {-0.00303324, -0.00251954, -0.00251615, -0.00273878, -0.00230557, -0.00523023, -0.0083075, -0.00524422, -0.00757441, -0.00701656, 0.000986708, -0.000442019, -0.02176, -0.0353217, -0.0359454, -0.0452065, 
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     -0.0137691, -0.0110359, -0.00606352, -0.0057564, -0.00786447, 0.00440244, 0.0190463, 0.0353584, 0.0425704, 0.0366991, 0.0306359, 0.0188414, 0.0125925, 0.0133959, 0.012744, 0.00818814},
};

int readMux(int channel)  
{ 
    int controlPin[] = {8, 9, 10, 11}; 
    int muxChannel[16][4] = { 
        {0,0,0,0},  
        {1,0,0,0}, //channel 1 
        {0,1,0,0}, //channel 2 
        {1,1,0,0}, //channel 3 
        {0,0,1,0}, //channel 4 
        {1,0,1,0}, //channel 5 
        {0,1,1,0}, //channel 6 
        {1,1,1,0}, //channel 7 
        {0,0,0,1}, //channel 8 
        {1,0,0,1}, //channel 9 
        {0,1,0,1}, //channel 10 
        {1,1,0,1}, //channel 11 
        {0,0,1,1}, //channel 12 
        {1,0,1,1}, //channel 13 
        {0,1,1,1}, //channel 14 
        {1,1,1,1}  //channel 15 
    }; 
  
    for(int i = 0; i < 4; i ++) { 
        digitalWrite(controlPin[i], muxChannel[channel][i]); 
    } 
    int val = analogRead(analogPin); 
    return val; 
}

float predict(float weights[16][32], float x[16][32]) 
{
    float z = 0.0;
    for (int i = 0; i < newHeight; ++i) 
    { 
        for (int j = 0; j < newWidth; ++j) 
        {
            z += weights[i][j] * x[i][j];
        }
    }
    return 1.0 / (1.0 + exp(-z));
}

float calculateX(float matrix[8][16], int i, int j) 
{
    float sum = 0.0f;
    int count = 0;

    // 8방향 이웃 탐색 (상, 하, 좌, 우, 대각선)
    for (int di = -1; di <= 1; ++di) {
        for (int dj = -1; dj <= 1; ++dj) {
            if (di == 0 && dj == 0) continue;  // 자기 자신은 제외
            int ni = i + di;
            int nj = j + dj;
            if (ni >= 0 && ni < height && nj >= 0 && nj < width) {
                sum += matrix[ni][nj];
                ++count;
            }
        }
    }

    if (count > 0) {
        return sum / count;  // 이웃 값들의 평균
    } else {
        return matrix[i][j];  // 이웃이 없으면 자기 자신의 값 반환
    }
}

// 선형 보간 함수
float linearInterpolate(float v0, float v1, float t) {
    return v0 * (1 - t) + v1 * t;
}

void processMatrix(float array[8][16], int Mask[8][16], float result[8][16]) 
{
    float sum = 0.0f, sum_sq = 0.0f;

    for (int i = 0; i < height; ++i) 
    {
        for (int j = 0; j < width; ++j) 
        {
            result[i][j] = array[i][j];
            sum += result[i][j];
            sum_sq += result[i][j] * result[i][j];
        }
    }

    int n = width * height;
    float mean = sum / n;
    float std_dev = sqrt((sum_sq / n) - (mean * mean));
    float Thup = mean + std_dev;
    float Thdn = mean - std_dev;

    for (int i = 0; i < height; ++i) 
    {
        for (int j = 0; j < width; ++j) 
        {
            if (result[i][j] < Thup && result[i][j] > Thdn) 
            {
                Mask[i][j] = 1;
            } else {
                Mask[i][j] = 0;
            }
        }
    }
  
    for (int i = 0; i < height; ++i) 
    {
        for (int j = 0; j < width; ++j) 
        {
            if (Mask[i][j] == 0) 
            {
                result[i][j] = result[i][j];
            } else 
            {
                result[i][j] = calculateX(result, i, j);
            }
        }  
    }
}

// 업스케일링 함수
void upscaleMatrix(float inputMatrix[8][16], float outputMatrix[16][32]) 
{
    for (int i = 0; i < newHeight; ++i) 
    {
        for (int j = 0; j < newWidth; ++j) 
        {
            float x = static_cast<float>(j) / (newWidth - 1) * (width - 1);
            float y = static_cast<float>(i) / (newHeight - 1) * (height - 1);
            
            int x0 = static_cast<int>(x);
            int y0 = static_cast<int>(y);

            int x1 = min(x0 + 1, width - 1);
            int y1 = min(y0 + 1, height - 1);

            float xFraction = x - x0;
            float yFraction = y - y0;

            float top = linearInterpolate(inputMatrix[y0][x0], inputMatrix[y0][x1], xFraction);
            float bottom = linearInterpolate(inputMatrix[y1][x0], inputMatrix[y1][x1], xFraction);
            outputMatrix[i][j] = linearInterpolate(top, bottom, yFraction);
        }
    }
}

void setup() 
{
  // put your setup code here, to run once:
  Serial.begin(9600);
  pinMode(2,OUTPUT);
  pinMode(3,OUTPUT);
  pinMode(4,OUTPUT);
  pinMode(5,OUTPUT);
  pinMode(6,OUTPUT);
  pinMode(8,OUTPUT);
  pinMode(9,OUTPUT);
  pinMode(10,OUTPUT);
  pinMode(11,OUTPUT);
}

void loop() 
{
  for (int i = 0; i < height; ++i)
  {
    digitalWrite(2, LOW);
    shiftOut(4, 3, LSBFIRST, 1 << i);  
    digitalWrite(2, HIGH);
    
    for(int j = 0; j < width; ++j)
    { 
     FirstMatrix[i][j] = readMux(j);
    } 
    delay(1);
  }
  
  processMatrix(FirstMatrix, MaskedMatrix, ProcessedMatrix);
  upscaleMatrix(ProcessedMatrix, UpscaledMatrix);

  if(predict(weights, UpscaledMatrix) < 0.5 )
  {
    digitalWrite(5,HIGH);
    digitalWrite(6,LOW);
    Serial.println("false");
  }else 
  {
    digitalWrite(6,HIGH);
    digitalWrite(5,LOW);
    Serial.println("true");
  }

  delay(100);
}
